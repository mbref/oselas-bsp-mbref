## Kconfig
```kconfig
mainmenu "Configuration"

# needed to handle tristates
config MODULES
        bool
        default y

menu "Project Specific Configuration"

source "generated/project_specific.in"
source "generated/fixme.in"

endmenu

source "generated/project_name.in"

menu "PTXdist Base Configuration    "

source "rules/Kconfig"

endmenu
```
